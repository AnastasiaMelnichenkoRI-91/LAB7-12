void setup() {
    DDRD = B11111111; // піни порту D (на платі 0-7 піни) позначаєм вихідними
    DDRB = B111111; // піни порту B (на платі 8-13 піни) позначаєм вихідними
    PORTB = B111111; // встановлюємо високий рівень пінів порта В (на платі 8-13 піни)
}

void loop() {
    int res = 0;

    for (int n1 = 7; n1 >= 1; n1--)
    {
        for (int n2 = n1 - 1; n2 >= 1; n2--)
        {
            for (int n3 = n2 - 1; n3 >= 1; n3--)
            {
                for (int n4 = n3 - 1; n4 >= 0; n4--)
                {
                    res = 0;
                    res += 1 << n1;
                    res += 1 << n2;
                    res += 1 << n3;
                    res += 1 << n4;
                    PORTD = res;
                    delay (500);
                }

            }
        }
    }
    
}
